## conf/layer.conf
```bitbake
# We have a conf and classes directory, add to BBPATH
BBPATH .= ":${LAYERDIR}"

# We have recipes-* directories, add to BBFILES
BBFILES += "${LAYERDIR}/recipes-*/*/*.bb \
	${LAYERDIR}/recipes-*/*/*.bbappend"

BBFILE_COLLECTIONS += "remote-management-raspberrypi"
BBFILE_PATTERN_remote-management-raspberrypi = "^${LAYERDIR}/"
BBFILE_PRIORITY_remote-management-raspberrypi = "6"
```
